## components/szpi_display/Kconfig
```kconfig
menu "SZPI display"

config SZPI_DISPLAY_SPI_CLOCK_HZ
    int "LCD SPI clock override in Hz (0 uses board default)"
    range 0 80000000
    default 0

config SZPI_DISPLAY_SPI_MODE
    int "LCD SPI mode"
    range 0 3
    default 2

endmenu
```

## main/Kconfig.projbuild
```kconfig
menu "SZPI application"

config SZPI_WIFI_ENABLED
    bool "Enable Wi-Fi station"
    default y
    help
        Enable the configured 2.4 GHz Wi-Fi station service.

config SZPI_WIFI_PROVISION_TIMEOUT_S
    int "Provisioning session timeout (seconds)"
    range 60 600
    default 600
    depends on SZPI_WIFI_ENABLED

config SZPI_OTA_ENABLED
    bool "Enable firmware OTA updates"
    default y
    help
        Enable manual firmware updates from the configured URL.

choice SZPI_SNTP_SERVER_MODE
    prompt "SNTP server source"
    default SZPI_SNTP_SERVER_CUSTOM
    help
        Select a configured NTP server or use the current STA IPv4 gateway.

config SZPI_SNTP_SERVER_CUSTOM
    bool "Configured server address"

config SZPI_SNTP_SERVER_GATEWAY
    bool "Use current Wi-Fi gateway"
    help
        Use the gateway from the accepted STA DHCP lease as the NTP server.
        The gateway must provide NTP on UDP port 123. This does not request
        DHCP option 42 and does not fall back to a public NTP server.

endchoice

config SZPI_SNTP_SERVER_ADDRESS
    string "SNTP server hostname or IP address"
    depends on SZPI_SNTP_SERVER_CUSTOM
    default "pool.ntp.org"
    help
        NTP server hostname or IP address, without a URL scheme or port.

config SZPI_OTA_URL
    string "Firmware image URL"
    default "http://localhost/ota/firmware.bin"
    depends on SZPI_OTA_ENABLED
    help
        URL of a complete ESP-IDF application image for this target.

endmenu
```
